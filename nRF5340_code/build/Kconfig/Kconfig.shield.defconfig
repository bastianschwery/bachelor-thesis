## nRF5340_code/build/Kconfig/Kconfig.shield.defconfig
```kconfig
osource "C:/Users/basti/ncs/nrf/boards/shields/*/Kconfig.defconfig"
osource "C:/Users/basti/ncs/zephyr/boards/shields/*/Kconfig.defconfig"
osource "C:/Users/basti/ncs/zephyr/boards/shields/*/Kconfig.defconfig"
```

## nRF5340_code/build/Kconfig/Kconfig.soc.arch
```kconfig
osource "C:/Users/basti/ncs/zephyr/soc/$(ARCH)/Kconfig"
osource "C:/Users/basti/ncs/zephyr/soc/$(ARCH)/*/Kconfig"
```

## nRF5340_code/build/hci_rpmsg/Kconfig/Kconfig.shield
```kconfig
osource "C:/Users/basti/ncs/nrf/boards/shields/*/Kconfig.shield"
osource "C:/Users/basti/ncs/zephyr/boards/shields/*/Kconfig.shield"
osource "C:/Users/basti/ncs/zephyr/boards/shields/*/Kconfig.shield"
```
