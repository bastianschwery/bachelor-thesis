## CMakeLists.txt
```
#
# Copyright (c) 2018 Nordic Semiconductor
#
# SPDX-License-Identifier: LicenseRef-Nordic-5-Clause
#
cmake_minimum_required(VERSION 3.13.1)
set(BOARD nrf5340dk_nrf5340_cpuappns)
find_package(Zephyr REQUIRED HINTS $ENV{ZEPHYR_BASE})
project(PerCen)

# NORDIC SDK APP START
target_sources(app PRIVATE
  src/main.cpp src/DeviceManager.h src/DeviceManager.cpp src/Data.h src/Data.cpp src/DataService.h src/DataService.cpp src/BatteryManager.h src/BatteryManager.c
)
# NORDIC SDK APP END
zephyr_library_include_directories(.)
```

## prj.conf
```kconfig
#
# Copyright (c) 2018 Nordic Semiconductor
#
# SPDX-License-Identifier: LicenseRef-Nordic-5-Clause
#
# General Bluetooth settings
CONFIG_NCS_SAMPLES_DEFAULTS=y
CONFIG_BT=y
CONFIG_SETTINGS=y
CONFIG_BT_SETTINGS=y
CONFIG_BT_PERIPHERAL=y
CONFIG_BT_CENTRAL=y
CONFIG_BT_GATT_DM=y
CONFIG_BT_GATT_CLIENT=y
CONFIG_BT_MAX_CONN=5
CONFIG_BT_DEVICE_NAME="Nordic nRF5340 DK"

# Enable the LBS service
CONFIG_BT_LBS=y
CONFIG_BT_LBS_POLL_BUTTON=y
CONFIG_DK_LIBRARY=y

# Enable the BAS service
CONFIG_BT_BAS_CLIENT=y

# Scan Settings
CONFIG_BT_SCAN=y
CONFIG_BT_SCAN_FILTER_ENABLE=y
CONFIG_BT_SCAN_UUID_CNT=2

# Console settings
CONFIG_RTT_CONSOLE=y
CONFIG_USE_SEGGER_RTT=y
CONFIG_UART_CONSOLE=n
```

## prj_minimal.conf
```kconfig
# BEGIN Configurations from basic/minimal

CONFIG_NCS_SAMPLES_DEFAULTS=y

CONFIG_BT=y
CONFIG_BT_PERIPHERAL=y
CONFIG_BT_CENTRAL=y
CONFIG_BT_DEVICE_NAME="Nordic_Blinky"

# Enable the LBS service
CONFIG_BT_LBS=y
CONFIG_BT_LBS_POLL_BUTTON=y
CONFIG_DK_LIBRARY=y

# Drivers and peripherals
CONFIG_I2C=n
CONFIG_WATCHDOG=n
CONFIG_GPIO=n
CONFIG_PINMUX=n
CONFIG_SPI=n
CONFIG_SERIAL=n

# Power management
CONFIG_PM=n

# Interrupts
CONFIG_DYNAMIC_INTERRUPTS=n
CONFIG_IRQ_OFFLOAD=n

# Memory protection
CONFIG_THREAD_STACK_INFO=n
CONFIG_THREAD_CUSTOM_DATA=n
CONFIG_FPU=n

# Boot
CONFIG_BOOT_BANNER=n
CONFIG_BOOT_DELAY=0

# Console
CONFIG_CONSOLE=n
CONFIG_UART_CONSOLE=n
CONFIG_STDOUT_CONSOLE=n
CONFIG_PRINTK=n
CONFIG_EARLY_CONSOLE=n

# Build
CONFIG_SIZE_OPTIMIZATIONS=y

# ARM
CONFIG_ARM_MPU=n
# END Configurations from basic/minimal

# In order to correctly tune the stack sizes for the threads the following
# Configurations can enabled to print the current use:
# CONFIG_THREAD_NAME=y
# CONFIG_THREAD_ANALYZER=y
# CONFIG_THREAD_ANALYZER_AUTO=y
# CONFIG_THREAD_ANALYZER_RUN_UNLOCKED=y
# CONFIG_THREAD_ANALYZER_USE_PRINTK=y
# CONFIG_CONSOLE=y
# CONFIG_UART_CONSOLE=y
# CONFIG_SERIAL=y
# CONFIG_PRINTK=y

# Example output of thread analyzer
# SDC RX              : unused 816 usage 208 / 1024 (20 %)
# BT RX               : unused 1784 usage 416 / 2200 (18 %)
# BT TX               : unused 992 usage 544 / 1536 (35 %)
# thread_analyzer     : unused 136 usage 376 / 512 (73 %)
# sysworkq            : unused 1824 usage 224 / 2048 (10 %)
# MPSL signal         : unused 520 usage 504 / 1024 (49 %)
# idle 00             : unused 192 usage 64 / 256 (25 %)
# main                : unused 136 usage 888 / 1024 (86 %)
# Configurations set based on thread analyzer output.
CONFIG_SDC_RX_STACK_SIZE=324
CONFIG_BT_RX_STACK_SIZE=1024
CONFIG_BT_HCI_TX_STACK_SIZE_WITH_PROMPT=y
CONFIG_BT_HCI_TX_STACK_SIZE=640
CONFIG_SYSTEM_WORKQUEUE_STACK_SIZE=256
CONFIG_MPSL_SIGNAL_STACK_SIZE=640
CONFIG_MAIN_STACK_SIZE=1024
CONFIG_IDLE_STACK_SIZE=128
CONFIG_ISR_STACK_SIZE=1024

# Disable features not needed
CONFIG_TIMESLICING=n
CONFIG_MINIMAL_LIBC_MALLOC=n
CONFIG_LOG=n
CONFIG_ASSERT=n

# Disable Bluetooth features not needed
CONFIG_BT_DEBUG_NONE=y
CONFIG_BT_ASSERT=n
CONFIG_BT_DATA_LEN_UPDATE=n
CONFIG_BT_PHY_UPDATE=n
CONFIG_BT_GATT_CACHING=n
CONFIG_BT_GATT_SERVICE_CHANGED=n
CONFIG_BT_GAP_PERIPHERAL_PREF_PARAMS=n
#CONFIG_BT_SETTINGS_CCC_LAZY_LOADING=y
CONFIG_BT_HCI_VS_EXT=n

# Disable Bluetooth controller features not needed
CONFIG_BT_CTLR_PRIVACY=n
CONFIG_BT_CTLR_PHY_2M=n

# Reduce Bluetooth buffers
CONFIG_BT_DISCARDABLE_BUF_COUNT=1
CONFIG_BT_DISCARDABLE_BUF_SIZE=45
CONFIG_BT_RX_BUF_COUNT=2

CONFIG_BT_CONN_TX_MAX=2
CONFIG_BT_L2CAP_TX_BUF_COUNT=2
CONFIG_BT_ATT_TX_MAX=1
CONFIG_BT_CTLR_RX_BUFFERS=1
CONFIG_BT_CTLR_TX_BUFFERS=3
CONFIG_BT_CTLR_TX_BUFFER_SIZE=27
```

## src/main.cpp
```c
/**
 * @file 	main.cpp
 * @author 	Schwery Bastian (bastian98@gmx.ch)
 * @brief 	This class creates a DeviceManager instance a
 * 			starts the application
 * @version 0.1
 * @date 	2021-05
 * 
 * @copyright Copyright (c) 2021
 * 
 */

#include "DeviceManager.h"

void main(void)
{

	printk("Application start\n");

	// create a new device manager
	DeviceManager dManager;
	// start application as peripheral and central
	dManager.setDevice(true,true);
} 	
```

## src/BatteryManager.c
```c
#include "BatteryManager.h"

/*---------------------------------------------------------------------------
 * PUBLIC VARIABLES
 *--------------------------------------------------------------------------*/ 
static struct bt_bas_client clients[3]; // the battery clients
static uint8_t batteryLevels[4];    // the battery levels of all sensors
static uint8_t cntDevices = 0;
static bool free = true;
static bool readyValues[3];
static bool service_found = true;
/*
* sensor infos has the following information about which sensors the user wants to connect:
* 1 -> just one speed sensor 
* 2 -> just one cadence sensor
* 3 -> one speed and one cadence sensor
* 4 -> one speed, one cadence and one heart rate sensor 
* 5 -> one speed and one heart rate sensor
* 6 -> one cadence and one heart rate sensor
* 7 -> just one heart rate sensor
*/
static uint8_t infoSensors = 0;

void discovery_completed_cb(struct bt_gatt_dm *dm, void *context)
{
	printk("The discovery procedure succeeded\n");
	service_found = true;
	bt_gatt_dm_data_print(dm);

	// subscribe battery service for the correct sensor
	switch (infoSensors)
	{
	case 1:
		subscribeBatterySpeed(dm);
		break;
	case 2:
		subscribeBatteryCadence(dm);
		break;
	case 3:
		if (cntDevices == 1)
		{
			subscribeBatterySpeed(dm);
		}
		else
		{
			subscribeBatteryCadence(dm);
		}
		break;
	case 4:
		if (cntDevices == 1)
		{
			subscribeBatterySpeed(dm);
		}
		else if (cntDevices == 2)
		{
			subscribeBatteryCadence(dm);
		}		
		else 
		{
			subscribeBatteryHeartRate(dm);
		}
		break;
	case 5:
		if (cntDevices == 1)
		{
			subscribeBatterySpeed(dm);
		}
		else
		{
			subscribeBatteryHeartRate(dm);
		}
		break;
	case 6:
		if (cntDevices == 1)
		{
			subscribeBatteryCadence(dm);
		}
		else
		{
			subscribeBatteryHeartRate(dm);
		}		
		break;		
	case 7:
			subscribeBatteryHeartRate(dm);
		break;							
	default:
		break;
	}
}

void discovery_service_not_found_cb(struct bt_conn *conn, void *context)
{
	printk("The service could not be found during the discovery\n");
	service_found = false;
	cntDevices--;
	free = true;
}

void discovery_error_found_cb(struct bt_conn *conn,
				     int err,
				     void *context)
{
	printk("The discovery procedure failed with %d\n", err);
	cntDevices--;
	free = true;
}

uint8_t gatt_discover_battery_service(struct bt_conn *conn)
{
	uint8_t err;
	free = false;
	static uint8_t cnt = 0;
	cnt++;
	
    static struct bt_gatt_dm_cb discovery_cb = {
        .completed = discovery_completed_cb,
        .service_not_found = discovery_service_not_found_cb,
        .error_found = discovery_error_found_cb,
    };

	err = bt_gatt_dm_start(conn, BT_UUID_BAS, &discovery_cb, NULL);
	if (err) 
	{
		printk("Could not start the discovery procedure, error "
		       "code: %d\n", err);
		cnt--;
		cntDevices--;
	}
	return err;
}

void read_battery_level_cb_speed(struct bt_bas_client *bas,
				  uint8_t battery_level,
				  int err)
{
	readyValues[SPEED] = true;
	char addr[BT_ADDR_LE_STR_LEN];

	bt_addr_le_to_str(bt_conn_get_dst(bt_bas_conn(bas)),
			  addr, sizeof(addr));
	if (err) 
	{
		printk("[%s] Battery read ERROR: %d\n", addr, err);
		return;
	}

	printk("[%s] Battery read: %"PRIu8"%%\n", addr, battery_level);
	batteryLevels[SPEED] = battery_level;
}

void read_battery_level_cb_cadence(struct bt_bas_client *bas,
				  uint8_t battery_level,
				  int err)
{
	readyValues[CADENCE] = true;
	char addr[BT_ADDR_LE_STR_LEN];

	bt_addr_le_to_str(bt_conn_get_dst(bt_bas_conn(bas)),
			  addr, sizeof(addr));
	if (err) 
	{
		printk("[%s] Battery read ERROR: %d\n", addr, err);
		return;
	}

	printk("[%s] Battery read: %"PRIu8"%%\n", addr, battery_level);
	batteryLevels[CADENCE] = battery_level;
}

void read_battery_level_cb_heartRate(struct bt_bas_client *bas,
				  uint8_t battery_level,
				  int err)
{
	readyValues[HEARTRATE] = true;
	char addr[BT_ADDR_LE_STR_LEN];

	bt_addr_le_to_str(bt_conn_get_dst(bt_bas_conn(bas)),
			  addr, sizeof(addr));
	if (err) 
	{
		printk("[%s] Battery read ERROR: %d\n", addr, err);
		return;
	}

	printk("[%s] Battery read: %"PRIu8"%%\n", addr, battery_level);
	batteryLevels[HEARTRATE] = battery_level;
}

void initBatteryManager(uint8_t sensorInfos)
{
	for (uint8_t i = 0; i <= 2; i++)
	{
		readyValues[i] = false;
		batteryLevels[i] = 0;
	}
	
	free = false;
	infoSensors = sensorInfos;
	cntDevices++;
	printk("Initialize battery manager: # %d\n", cntDevices);

	switch (sensorInfos)
	{
	case 1:
		bt_bas_client_init(&clients[SPEED]);
		break;
	case 2:
		bt_bas_client_init(&clients[CADENCE]);
		break;
	case 3:
		if (cntDevices == 1)
		{
			bt_bas_client_init(&clients[SPEED]);
		}
		else
		{
			bt_bas_client_init(&clients[CADENCE]);
		}
		break;
	case 4:
		if (cntDevices == 1)
		{
			bt_bas_client_init(&clients[SPEED]);
		}
		else if (cntDevices == 2)
		{
			bt_bas_client_init(&clients[CADENCE]);
		}	
		else
		{
			bt_bas_client_init(&clients[HEARTRATE]);
		}
		break;
	case 5:
		if (cntDevices == 1)
		{
			bt_bas_client_init(&clients[SPEED]);
		}
		else
		{
			bt_bas_client_init(&clients[HEARTRATE]);
		}
		break;
	case 6:
		if (cntDevices == 1)
		{
			bt_bas_client_init(&clients[CADENCE]);
		}
		else
		{
			bt_bas_client_init(&clients[HEARTRATE]);
		}	
		break;
	case 7:
		bt_bas_client_init(&clients[HEARTRATE]);
		break;				
	default:
		break;
	}
}

uint8_t getBatteryLevel(uint8_t nbrSensor) 
{
    uint8_t defaultValue = 0;
	switch (nbrSensor)
	{
	case 1:
		return batteryLevels[SPEED];	
		break;
	case 2:
		return batteryLevels[CADENCE];
		break;
	case 3:
		return batteryLevels[HEARTRATE];
		break;
	default:
		batteryLevels[DEFAULT] = 0;
		return batteryLevels[DEFAULT];
		break;
	}

    return defaultValue;
}

void subscribeBatterySpeed(struct bt_gatt_dm *dm) 
{
	uint8_t err = 0;

	err = bt_bas_handles_assign(dm, &clients[SPEED]);
	if (err) 
	{
		printk("Could not init BAS client object from speed sensor, error: %d\n", err);
	}

	err = bt_gatt_dm_data_release(dm);
	if (err) 
	{
		printk("Could not release the discovery data, error "
		       "code: %d\n", err);
	}
	free = true;
}

void subscribeBatteryCadence(struct bt_gatt_dm *dm) 
{
	uint8_t err = 0;

	err = bt_bas_handles_assign(dm, &clients[CADENCE]);
	if (err) 
	{
		printk("Could not init BAS client object from cadence sensor, error: %d\n", err);
	}

	err = bt_gatt_dm_data_release(dm);
	if (err) 
	{
		printk("Could not release the discovery data, error "
		       "code: %d\n", err);
	}

	free = true;
}

void subscribeBatteryHeartRate(struct bt_gatt_dm *dm) 
{
	uint8_t err = 0;

	err = bt_bas_handles_assign(dm, &clients[HEARTRATE]);
	if (err) 
	{
		printk("Could not init BAS client object from heart rate sensor, error: %d\n", err);
	}

	err = bt_gatt_dm_data_release(dm);
	if (err) 
	{
		printk("Could not release the discovery data, error "
		       "code: %d\n", err);
	}	
	
	free = true;
}

bool isFree()
{
	return free;
}

void askForBatteryLevel(uint8_t type)
{
	switch (type)
	{
	case 1:
		readyValues[SPEED] = false;
		bt_bas_read_battery_level(&clients[SPEED], read_battery_level_cb_speed);
		break;
	case 2: 
		readyValues[CADENCE] = false;
		bt_bas_read_battery_level(&clients[CADENCE], read_battery_level_cb_cadence);
		break;
	case 3:
		readyValues[HEARTRATE] = false;
		bt_bas_read_battery_level(&clients[HEARTRATE], read_battery_level_cb_heartRate);
		break;
	default:
		break;
	}
}

bool isValueReady(uint8_t type)
{
	switch (type)
	{
	case 1:
		return readyValues[SPEED];
		break;
	case 2:
		return readyValues[CADENCE];
		break;
	case 3:
		return readyValues[HEARTRATE];
		break;			
	default:
		return false;
		break;
	}	
}

void resetReadyValue(uint8_t type)
{
	switch (type)
	{
	case 1:
		readyValues[SPEED] = false;
		break;
	case 2:
		readyValues[CADENCE] = false;
		break;
	case 3:
		readyValues[HEARTRATE] = false;
		break;			
	default:
		break;
	}		
}

bool serviceFound()
{
	return service_found;
}
```

## src/BatteryManager.cpp
```c
/*
 * Copyright (c) 2019 Nordic Semiconductor ASA
 *
 * SPDX-License-Identifier: LicenseRef-Nordic-5-Clause
 */

/** @file
 *  @brief Nordic Battery Service Client sample
 */
#include "BatteryManager.h"
#include <bluetooth/services/bas_client.h>

//static struct bt_bas_client bas;

bt_bas_client BatteryManager::bas_sensor1;
bt_bas_client BatteryManager::bas_sensor2;
bt_bas_client BatteryManager::bas_sensor3;
uint8_t BatteryManager::cntDevices = 0;
uint8_t BatteryManager::batteryLevel_sensor1 = 0;
uint8_t BatteryManager::batteryLevel_sensor2 = 0;
uint8_t BatteryManager::batteryLevel_sensor3 = 0;

BatteryManager::BatteryManager()
{
	
}

void BatteryManager::discovery_completed_cb(struct bt_gatt_dm *dm, void *context)
{
	int err;

	printk("The discovery procedure succeeded\n");

	bt_gatt_dm_data_print(dm);

	switch (cntDevices)
	{
	case 1:
		err = bt_bas_handles_assign(dm, &bas_sensor1);
		if (err) 
		{
			printk("Could not init BAS client object from sensor 1, error: %d\n", err);
		}

		if (bt_bas_notify_supported(&bas_sensor1))
		{
			err = bt_bas_subscribe_battery_level(&bas_sensor1, notify_battery_level_cb_sensor1);
			if (err) 
			{
				printk("Cannot subscribe to BAS value notification from sensor 1, (err: %d)\n", err);
			}
		} else 
		{
			err = bt_bas_start_per_read_battery_level(&bas_sensor1, BAS_READ_VALUE_INTERVAL, notify_battery_level_cb_sensor1);
			if (err) 
			{
				printk("Could not start periodic read of BAS value for sensor 1\n");
			}
		}
		break;
	case 2:
		err = bt_bas_handles_assign(dm, &bas_sensor2);
		if (err) 
		{
			printk("Could not init BAS client object from sensor 2, error: %d\n", err);
		}

		if (bt_bas_notify_supported(&bas_sensor2))
		{
			err = bt_bas_subscribe_battery_level(&bas_sensor2, notify_battery_level_cb_sensor2);
			if (err) 
			{
				printk("Cannot subscribe to BAS value notification from sensor 2, (err: %d)\n", err);
			}
		} else 
		{
			err = bt_bas_start_per_read_battery_level(&bas_sensor2, BAS_READ_VALUE_INTERVAL, notify_battery_level_cb_sensor2);
			if (err) 
			{
				printk("Could not start periodic read of BAS value for sensor 2\n");
			}
		}	
		break;
	case 3:
		err = bt_bas_handles_assign(dm, &bas_sensor3);
		if (err) 
		{
			printk("Could not init BAS client object from sensor 3, error: %d\n", err);
		}

		if (bt_bas_notify_supported(&bas_sensor3))
		{
			err = bt_bas_subscribe_battery_level(&bas_sensor3, notify_battery_level_cb_sensor3);
			if (err) 
			{
				printk("Cannot subscribe to BAS value notification from sensor 3, (err: %d)\n", err);
			}
		} else 
		{
			err = bt_bas_start_per_read_battery_level(&bas_sensor3, BAS_READ_VALUE_INTERVAL, notify_battery_level_cb_sensor3);
			if (err) 
			{
				printk("Could not start periodic read of BAS value for sensor 3\n");
			}
		}	
		break;
	default:
		break;
	}

	

	err = bt_gatt_dm_data_release(dm);
	if (err) {
		printk("Could not release the discovery data, error "
		       "code: %d\n", err);
	}
}

void BatteryManager::discovery_service_not_found_cb(struct bt_conn *conn,
					   void *context)
{
	printk("The service could not be found during the discovery\n");
}

void BatteryManager::discovery_error_found_cb(struct bt_conn *conn,
				     int err,
				     void *context)
{
	printk("The discovery procedure failed with %d\n", err);
}

void BatteryManager::gatt_discover(struct bt_conn *conn)
{
	int err;

    static struct bt_gatt_dm_cb discovery_cb = {
        .completed = discovery_completed_cb,
        .service_not_found = discovery_service_not_found_cb,
        .error_found = discovery_error_found_cb,
    };

	err = bt_gatt_dm_start(conn, BT_UUID_BAS, &discovery_cb, NULL);
	if (err) {
		printk("Could not start the discovery procedure, error "
		       "code: %d\n", err);
	}
}

void BatteryManager::notify_battery_level_cb_sensor1(struct bt_bas_client *bas,
				    uint8_t battery_level)
{
	char addr[BT_ADDR_LE_STR_LEN];

	bt_addr_le_to_str(bt_conn_get_dst(bt_bas_conn(bas)),
			  addr, sizeof(addr));
	if (battery_level == BT_BAS_VAL_INVALID) {
		printk("[%s] Battery notification aborted\n", addr);
	} else {
		printk("[%s] Battery notification: %"PRIu8"%%\n",
		       addr, battery_level);
	}

	batteryLevel_sensor1 = battery_level;
}

void BatteryManager::notify_battery_level_cb_sensor2(struct bt_bas_client *bas,
				    uint8_t battery_level)
{
	char addr[BT_ADDR_LE_STR_LEN];

	bt_addr_le_to_str(bt_conn_get_dst(bt_bas_conn(bas)),
			  addr, sizeof(addr));
	if (battery_level == BT_BAS_VAL_INVALID) {
		printk("[%s] Battery notification aborted\n", addr);
	} else {
		printk("[%s] Battery notification: %"PRIu8"%%\n",
		       addr, battery_level);
	}

	batteryLevel_sensor2 = battery_level;
}

void BatteryManager::notify_battery_level_cb_sensor3(struct bt_bas_client *bas,
				    uint8_t battery_level)
{
	char addr[BT_ADDR_LE_STR_LEN];

	bt_addr_le_to_str(bt_conn_get_dst(bt_bas_conn(bas)),
			  addr, sizeof(addr));
	if (battery_level == BT_BAS_VAL_INVALID) {
		printk("[%s] Battery notification aborted\n", addr);
	} else {
		printk("[%s] Battery notification: %"PRIu8"%%\n",
		       addr, battery_level);
	}

	batteryLevel_sensor3 = battery_level;
}

void BatteryManager::read_battery_level_cb(struct bt_bas_client *bas,
				  uint8_t battery_level,
				  int err)
{
	char addr[BT_ADDR_LE_STR_LEN];

	//bt_addr_le_to_str(bt_conn_get_dst(bt_bas_conn(bas)),
			//  addr, sizeof(addr));
	if (err) {
		printk("[%s] Battery read ERROR: %d\n", addr, err);
		return;
	}

	printk("[%s] Battery read: %"PRIu8"%%\n", addr, battery_level);
    //batteryLevel = battery_level;
}

void BatteryManager::button_readval(void)
{
	int err;

	printk("Reading BAS value:\n");
	//err = bt_bas_read_battery_level(&bas, read_battery_level_cb);
	if (err) {
		printk("BAS read call error: %d\n", err);
	}
}


void BatteryManager::button_handler(uint32_t button_state, uint32_t has_changed)
{
	uint32_t button = button_state & has_changed;

	if (button & KEY_READVAL_MASK) {
		button_readval();
	}
}

void BatteryManager::initBatteryManager(void)
{
	int err;
	cntDevices++;
	printk("Starting Bluetooth Central BAS example\n");

	switch (cntDevices)
	{
	case 1:
		bt_bas_client_init(&bas_sensor1);
		break;
	case 2:
		bt_bas_client_init(&bas_sensor2);
		break;
	case 3:
		bt_bas_client_init(&bas_sensor3);
		break;
	default:
		break;
	}
	
	err = dk_buttons_init(button_handler);
	if (err) {
		printk("Failed to initialize buttons (err %d)\n", err);
		return;
	}
}

uint8_t BatteryManager::getBatteryLevel(uint8_t nbrSensor) 
{
    int err;

	printk("Reading BAS value:\n");

	switch (nbrSensor)
	{
	case 1:
		err = bt_bas_read_battery_level(&bas_sensor1, read_battery_level_cb);
		break;
	case 2:
		err = bt_bas_read_battery_level(&bas_sensor2, read_battery_level_cb);
		break;
	case 3:
		err = bt_bas_read_battery_level(&bas_sensor3, read_battery_level_cb);
		break;
	default:
		break;
	}

	if (err)
    {
		printk("BAS read call error: %d\n", err);
	}

    return err;
}
```

## src/BatteryManager.h
```c
/**
 * @file    BatteryManager.h
 * @author  Schwery Bastian (bastian98@gmx.ch)
 * @brief   Handles battery service -> gets new battery values
 * @version 0.1
 * @date    2021-07
 * 
 * @copyright Copyright (c) 2021
 * 
 */

/*---------------------------------------------------------------------------
 * INCLUDES
 *--------------------------------------------------------------------------*/ 
#include <bluetooth/services/bas_client.h>

/*---------------------------------------------------------------------------
 * DEFINES
 *--------------------------------------------------------------------------*/ 
#define SPEED 0
#define CADENCE 1
#define HEARTRATE 2
#define DEFAULT 3

/**
 * @brief callback function, is called when discovery is completed
 * 
 * @param dm holds the address of the connected device, user context and discover parameter 
 * @param context context, not used in this case
 */
void discovery_completed_cb(struct bt_gatt_dm *dm, void *context);

/**
 * @brief callback function, is called when the battery service was not found
 * 
 * @param conn connection structure which does not include the service
 * @param context context, not used in this case
 */
void discovery_service_not_found_cb(struct bt_conn *conn, void *context);

/**
 * @brief callback function, is called when an error occurs while discovering the battery service
 * 
 * @param conn connection structure which the error occurs
 * @param err error code, 0 if success
 * @param context context, not used in this case
 */
void discovery_error_found_cb(struct bt_conn *conn, int err, void *context);

/**
 * @brief start discovering the battery service
 * 
 * @param conn the connection to search the battery service 
 */
uint8_t gatt_discover_battery_service(struct bt_conn *conn);

/**
 * @brief callback function, is called when user requests the battery level of speed sensor
 * 
 * @param bas the battery service client
 * @param battery_level the battery level (0-100%)
 * @param err the error code, 0 if success
 */
void read_battery_level_cb_speed(struct bt_bas_client *bas, uint8_t battery_level, int err);

/**
 * @brief callback function, is called when user requests the battery level of cadence sensor
 * 
 * @param bas the battery service client
 * @param battery_level the battery level (0-100%)
 * @param err the error code, 0 if success
 */
void read_battery_level_cb_cadence(struct bt_bas_client *bas, uint8_t battery_level, int err);

/**
 * @brief callback function, is called when user requests the battery level of heart rate sensor
 * 
 * @param bas the battery service client
 * @param battery_level the battery level (0-100%)
 * @param err the error code, 0 if success
 */
void read_battery_level_cb_heartRate(struct bt_bas_client *bas, uint8_t battery_level, int err);

/**
 * @brief get the battery level 
 * 
 * @param nbrSensor from which sensor the battery level is requested
 * @return uint8_t the battery level (0-100%)
 */
uint8_t getBatteryLevel(uint8_t nbrSensor);

/**
 * @brief initialize the battery manager
 * 
 * @param sensorInfos info about which sensors are connected
 */
void initBatteryManager(uint8_t sensorInfos);

/**
 * @brief subscribe the battery service for speed sensor
 * 
 * @param dm holds the address of the connected device, user context and discover parameter 
 */
void subscribeBatterySpeed(struct bt_gatt_dm *dm);

/**
 * @brief subscribe the battery service for cadence sensor
 * 
 * @param dm holds the address of the connected device, user context and discover parameter  
 */
void subscribeBatteryCadence(struct bt_gatt_dm *dm);

/**
 * @brief subscribe the battery service for heart rate sensor
 * 
 * @param dm holds the address of the connected device, user context and discover parameter  
 */
void subscribeBatteryHeartRate(struct bt_gatt_dm *dm);

/**
 * @brief check if battery service client is busy
 * 
 * @return true if its free
 * @return false if its busy
 */
bool isFree();

/**
 * @brief ask heart rate sensor for the battery level
 * 
 * @param type which sensor ask for battery level
 */
void askForBatteryLevel(uint8_t type);

/**
 * @brief check if the battery level value is ready to read
 * 
 * @param type which sensor is checking ready attribute
 * @return true when battery level value is ready to read
 * @return false when battery level value is not ready to read
 */
bool isValueReady(uint8_t type);

/**
 * @brief reset the ready value
 * 
 * @param type which sensor wants to reset ready attribute
 */
void resetReadyValue(uint8_t type);

/**
 * @brief get information if service was not found
 * 
 * @return true when service found
 * @return false when service not found
 */
bool serviceFound();
```

## src/Data.cpp
```c
#include "Data.h"

Data::Data() 
{
    sumRevSpeed = 0;
    oldSumRevSpeed = 0;
    sumRevCadence = 0;
    oldSumRevCadence = 0;
    lastEventSpeed = 0;
    oldLastEventSpeed = 0;
    lastEventCadence = 0;
    oldLastEventCadence = 0;
    type = 0;
    wheelDiameter = 0.0;
    heartRate = 0;
    battValue_speed = 0;
    battValue_cadence = 0;
    battValue_heartRate = 0;
    speed = 0;
    rpm = 0;
}

void Data::saveData(const void *data) 
{
    type = ((uint8_t*)data)[0];
    switch (type)
    {
    case CSC_SPEED:
        // save old values
        oldSumRevSpeed = sumRevSpeed;
        oldLastEventSpeed = lastEventSpeed;

        // save new values
        sumRevSpeed = sys_get_le16(&((uint8_t*)data)[1]);
		lastEventSpeed = sys_get_le16(&((uint8_t*)data)[5]);
        break;
    case CSC_CADENCE:
        // save old values
        oldSumRevCadence = sumRevCadence;
        oldLastEventCadence  = lastEventCadence;
        // save new values
		sumRevCadence = sys_get_le16(&((uint8_t*)data)[1]);
		lastEventCadence  = sys_get_le16(&((uint8_t*)data)[3]);
        break;
    default:
        printk("Unknown type\n");
        break;
    }
}

uint16_t Data::calcRPM() 
{
    uint16_t retVal = 0;
    uint16_t maxVal = 0xffff;
    uint16_t nbrRev = sumRevCadence-oldSumRevCadence;

    if (nbrRev < 0)
    {
        nbrRev = maxVal - oldSumRevCadence + sumRevCadence;
    }
    
    if ((lastEventCadence != oldLastEventCadence) && (nbrRev))
    {
        double time = (lastEventCadence - oldLastEventCadence)/1024.0;

        if (time < 0)
        {
            time = 0xffff - oldLastEventCadence + lastEventCadence;
        }
        
        rpm = (sumRevCadence - oldSumRevCadence) * 60 / time;
        retVal = (uint16_t) rpm;
    }

    return retVal;
}

uint16_t Data::calcSpeed() 
{
    uint16_t retVal = 0;
    uint16_t nbrRevSpeed = sumRevSpeed - oldSumRevSpeed;
    uint32_t maxVal = 0xffffffff;   // 32 bit
    double wheelCircumference = 0;
    double rpm_speed = 0;
    static uint16_t totalTime = 0;
    static uint8_t cntNbr = 0;
    
    if (nbrRevSpeed < 0)
    {
        nbrRevSpeed = maxVal - oldSumRevSpeed + sumRevSpeed;
    }

    if ((lastEventSpeed != oldLastEventSpeed) && nbrRevSpeed > 0)
    {
        wheelCircumference = wheelDiameter;
        wheelCircumference = (wheelDiameter) * PI;
        double time = (lastEventSpeed - oldLastEventSpeed)/1024.0;
        cntNbr++;
        totalTime += time;
        if (cntNbr == 30)
        {
            cntNbr = 0;
            printk("Total time is: %d\n",totalTime);
            totalTime = 0;
        }
        
        double oldSpeed = speed;

        if (time < 0)
        {
            time = (0xffff - oldLastEventSpeed + lastEventSpeed)/1024;
        }
        
        if (sumRevSpeed == oldSumRevSpeed)
        {
            return 0;
        }
        else   
        {
            rpm_speed = (nbrRevSpeed) * 60 / time;
            speed = (rpm_speed * wheelCircumference) * 60 / 1000; // km/h * 100 for 2 values after the comma
            retVal = (uint16_t) (speed);
            return retVal;
        }  
    }
    return 0;
}
```

## src/Data.h
```c
/**
 * @file Data.h
 * @author Schwery Bastian (bastian98@gmx.ch)
 * @brief This class saves all the received 
 *        data from the nRF5340 and calculates
 *        the speed and the cadence
 * @version 0.1
 * @date 2021-06
 * 
 * @copyright Copyright (c) 2021
 * 
 */

/*---------------------------------------------------------------------------
 * INCLUDES
 *--------------------------------------------------------------------------*/ 
#include <sys/byteorder.h>

/*---------------------------------------------------------------------------
 * DEFINES
 *--------------------------------------------------------------------------*/ 
#define CSC_SPEED 1
#define CSC_CADENCE 2
#define PI 3.1415926

class Data {
public:
    /**
     * @brief constructor
     * 
     */
    Data();

    /** @brief save the new received data
     * 
     * @param data the new received data pointer 
     */
    void saveData(const void *data);

    /** @brief function to calculate rpm with the previously saved values
     * 
     * @return rounds per minute value
     */
    uint16_t calcRPM();

    /** @brief function to calculate speed with the previously saved values
     * 
     * @return speed in km/h
     */
    uint16_t calcSpeed();

    // received data from the CSC sensors
    uint16_t sumRevSpeed;
    uint16_t oldSumRevSpeed;
    uint16_t sumRevCadence;
    uint16_t oldSumRevCadence;
    uint16_t lastEventSpeed;
    uint16_t oldLastEventSpeed;
    uint16_t lastEventCadence;
    uint16_t oldLastEventCadence;
    uint8_t type;

    // received data from application
    double wheelDiameter;

    // received data from heart rate sensor
    uint8_t heartRate;

    // received battery values from the sensors
    uint8_t battValue_speed;
    uint8_t battValue_cadence;
    uint8_t battValue_heartRate;

    // attributes for calculations
private:
    double speed;
    double rpm;
};
```

## src/dataCSC.cpp
```c
#include "dataCSC.h"

dataCSC::dataCSC() 
{
    sumRevSpeed = 0;
    oldSumRevSpeed = 0;
    sumRevCadence = 0;
    oldSumRevCadence = 0;
    lastEventSpeed = 0;
    oldLastEventSpeed = 0;
    lastEventCadence = 0;
    oldLastEventCadence = 0;
    type = 0;
    wheelDiameter = 0.0;
    heartRate = 0;
    battValue_speed = 0;
    battValue_cadence = 0;
    battValue_heartRate = 0;
    speed = 0;
    rpm = 0;
}

void dataCSC::saveData(const void *data) 
{
    type = ((uint8_t*)data)[0];
    switch (type)
    {
    case CSC_SPEED:
        // save old values
        oldSumRevSpeed = sumRevSpeed;
        oldLastEventSpeed = lastEventSpeed;

        // save new values
        sumRevSpeed = sys_get_le16(&((uint8_t*)data)[1]);
		lastEventSpeed = sys_get_le16(&((uint8_t*)data)[5]);
        break;
    case CSC_CADENCE:
        // save old values
        oldSumRevCadence = sumRevCadence;
        oldLastEventCadence  = lastEventCadence;
        // save new values
		sumRevCadence = sys_get_le16(&((uint8_t*)data)[1]);
		lastEventCadence  = sys_get_le16(&((uint8_t*)data)[3]);
        break;
    default:
        printk("Unknown type\n");
        break;
    }
}

uint16_t dataCSC::calcRPM() 
{
    uint16_t retVal = 0;
    uint16_t maxVal = 0xffff;
    uint16_t nbrRev = sumRevCadence-oldSumRevCadence;

    if (nbrRev < 0)
    {
        nbrRev = maxVal - oldSumRevCadence + sumRevCadence;
    }
    
    if ((lastEventCadence != oldLastEventCadence) && (nbrRev))
    {
        double time = (lastEventCadence - oldLastEventCadence)/1024.0;

        if (time < 0)
        {
            time = 0xffff - oldLastEventCadence + lastEventCadence;
        }
        
        rpm = (sumRevCadence - oldSumRevCadence) * 60 / time;
        retVal = (uint16_t) rpm;
    }

    return retVal;
}

uint16_t dataCSC::calcSpeed() 
{
    uint16_t retVal = 0;
    uint16_t nbrRevSpeed = sumRevSpeed - oldSumRevSpeed;
    uint32_t maxVal = 0xffffffff;   // 32 bit
    double wheelCircumference = 0;
    double rpm_speed = 0;
    
    if (nbrRevSpeed < 0)
    {
        nbrRevSpeed = maxVal - oldSumRevSpeed + sumRevSpeed;
    }

    if ((lastEventSpeed != oldLastEventSpeed) && nbrRevSpeed > 0)
    {
        wheelCircumference = wheelDiameter;
        wheelCircumference = (wheelDiameter) * PI;
        double time = (lastEventSpeed - oldLastEventSpeed)/1024.0;
        double oldSpeed = speed;

        if (time < 0)
        {
            time = (0xffff - oldLastEventSpeed + lastEventSpeed)/1024;
        }
        
        if (sumRevSpeed == oldSumRevSpeed)
        {
            return (uint16_t) oldSpeed;
        }
        else   
        {
            rpm_speed = (nbrRevSpeed) * 60 / time;
            speed = (rpm_speed * wheelCircumference) * 60 / 1000; // km/h * 100 for the values after the comma
            retVal = (uint16_t) (speed);
            return retVal;
        }  
    }
    return 0;
}
```

## src/dataCSC.h
```c
/**
 * @file dataCSC.h
 * @author Schwery Bastian (bastian98@gmx.ch)
 * @brief This class saves all the received 
 *        data from the nRF5340 and calculates
 *        the speed and the cadence
 * @version 0.1
 * @date 2021-06
 * 
 * @copyright Copyright (c) 2021
 * 
 */
#include <stdint.h>
#include <bluetooth/bluetooth.h>
#include <sys/byteorder.h>

/*---------------------------------------------------------------------------
 * DEFINES
 *--------------------------------------------------------------------------*/ 
#define CSC_SPEED 1
#define CSC_CADENCE 2
#define PI 3.1515926

class dataCSC {
public:
    /**
     * @brief constructor
     * 
     */
    dataCSC();

    /** @brief save the new received data
     * 
     * @param data the new received data pointer 
     */
    void saveData(const void *data);

    /** @brief function to calculate rpm with the previously saved values
     * 
     * @return rounds per minute value
     */
    uint16_t calcRPM();

    /** @brief function to calculate speed with the previously saved values
     * 
     * @return speed in km/h
     */
    uint16_t calcSpeed();

    // received data from the CSC sensors
    uint16_t sumRevSpeed;
    uint16_t oldSumRevSpeed;
    uint16_t sumRevCadence;
    uint16_t oldSumRevCadence;
    uint16_t lastEventSpeed;
    uint16_t oldLastEventSpeed;
    uint16_t lastEventCadence;
    uint16_t oldLastEventCadence;
    uint8_t type;

    // received data from application
    double wheelDiameter;

    // received data from heart rate sensor
    uint8_t heartRate;

    // received battery values from the sensors
    uint8_t battValue_speed;
    uint8_t battValue_cadence;
    uint8_t battValue_heartRate;

    // attributes for calculations
private:
    double speed;
    double rpm;
};
```

## src/dataService.cpp
```c
#include "DataService.h"

/*---------------------------------------------------------------------------
 * GLOBAL VARIABLES
 *--------------------------------------------------------------------------*/ 
uint8_t cntAddresses = 0;
uint8_t diameter;
double dia;
uint8_t nbrAddresses = 0;
char address1[17];
char address2[17];
char address3[17];
uint8_t infoSensors = 0;
bool notificationsOn = false;

// data arrays
uint8_t data_rx[MAX_TRANSMIT_SIZE];
uint8_t data_tx[MAX_TRANSMIT_SIZE];

// must be called befor sending/receiving data
uint8_t data_service_init(void)
{
    uint8_t err = 0;

    memset(&data_rx, 0, MAX_TRANSMIT_SIZE);
    memset(&data_tx, 0, MAX_TRANSMIT_SIZE);

    return err;
}

// This function is called whenever the RX Characteristic has been written to by a Client 
static ssize_t on_receive(struct bt_conn *conn,
			  const struct bt_gatt_attr *attr,
			  const void *buf,
			  uint16_t len,
			  uint16_t offset,
			  uint8_t flags)
{
    const uint8_t * buffer = (uint8_t *) buf;
    
    // len = 1 -> new diameter received - or diameter reset (when 0)
    if (len == 1)
    {
        diameter = (uint8_t ) *buffer;

        // check if last bit is '1', then add 0.5 to dia and convert it to cm
        if ((diameter & 0b10000000) == 0b10000000)
        {
            dia = (diameter + 0.5) * 2.54;
        }
        else 
        {
            dia = diameter * 2.54;
        }
    }   
    
    // len = 19 -> addresses of one or more sensors to connect, received
    // bits 0-17 address, bit 18 nbr of total addresses, bit 19 info about which sensors to connect
    if (len == 19)
    {
        nbrAddresses = (uint8_t) buffer[17];
        infoSensors = (uint8_t) buffer[18];

        switch (nbrAddresses)
        {
        case 1:
            for (uint8_t i=0; i<17; i++)
            {
                uint8_t val = (uint8_t) buffer[i];
                char charToSave = (char) val;
                address1[i] = charToSave;
            } 
            break;
        case 2:
            cntAddresses++;
            if (cntAddresses == 1)
            {
                for (uint8_t i=0; i<17; i++)
                {
                    uint8_t val = (uint8_t) buffer[i];
                    char charToSave = (char) val;
                    address1[i] = charToSave;
                } 
            }
            else if (cntAddresses == 2)
            {
                for (uint8_t i=0; i<17; i++)
                {
                    uint8_t val = (uint8_t) buffer[i];
                    char charToSave = (char) val;
                    address2[i] = charToSave;
                } 
                cntAddresses = 0;
            }
            break;
        case 3:
            cntAddresses++;
            if (cntAddresses == 1)
            {
                for (uint8_t i=0; i<17; i++)
                {
                    uint8_t val = (uint8_t) buffer[i];
                    char charToSave = (char) val;
                    address1[i] = charToSave;
                } 
            }
            else if (cntAddresses == 2)
            {
                for (uint8_t i=0; i<17; i++)
                {
                    uint8_t val = (uint8_t) buffer[i];
                    char charToSave = (char) val;
                    address2[i] = charToSave;
                } 
            } else if (cntAddresses == 3)
            {
                for (uint8_t i=0; i<17; i++)
                {
                    uint8_t val = (uint8_t) buffer[i];
                    char charToSave = (char) val;
                    address3[i] = charToSave;
                } 
                cntAddresses = 0;
            }     
            break;
        default:
            break;
        }
    }
    
	printk("Received data, handle %d, conn %p, data: 0x", attr->handle, conn);
 
    for(uint8_t i = 0; i < len; i++)
    {
        printk("%02X", buffer[i]);
    }
    printk("\n");
 	return len;
}

// This function is called whenever a notification has been sent by the TX Characteristic 
static void on_sent(struct bt_conn *conn, void *user_data)
{
	ARG_UNUSED(user_data);

    const bt_addr_le_t * addr = bt_conn_get_dst(conn);
    printk("Data sent to Address 0x %02X %02X %02X %02X %02X %02X \n", addr->a.val[0]
                                                                , addr->a.val[1]
                                                                , addr->a.val[2]
                                                                , addr->a.val[3]
                                                                , addr->a.val[4]
                                                                , addr->a.val[5]);
}

// This function is called whenever the CCCD register has been changed by the client
void on_cccd_changed(const struct bt_gatt_attr *attr, uint16_t value)
{
    ARG_UNUSED(attr);

    switch(value)
    {
        case BT_GATT_CCC_NOTIFY: 
            // Start sending stuff!
            printk("Notifications ON\n");
            notificationsOn = true;
            break;

        case BT_GATT_CCC_INDICATE: 
            // Start sending stuff via indications
            printk("Notifications ON with Indications\n");
            notificationsOn = true;
            break;

        case 0: 
            // Stop sending stuff
            printk("Notifications OFF\n");
            notificationsOn = false;
            break;
        
        default: 
            printk("Error, CCCD has been set to an invalid value\n");     
    }
}
                        
// Data service declaration and registration 
BT_GATT_SERVICE_DEFINE(data_service,
BT_GATT_PRIMARY_SERVICE(BT_UUID_DATA_SERVICE),
BT_GATT_CHARACTERISTIC(BT_UUID_DATA_SERVICE_RX,
			       BT_GATT_CHRC_WRITE | BT_GATT_CHRC_WRITE_WITHOUT_RESP,
			       BT_GATT_PERM_READ | BT_GATT_PERM_WRITE, 
                   NULL, on_receive, NULL),
BT_GATT_CHARACTERISTIC(BT_UUID_DATA_SERVICE_TX,
			       BT_GATT_CHRC_NOTIFY,
			       BT_GATT_PERM_READ,
                   NULL, NULL, NULL),
BT_GATT_CCC(on_cccd_changed,
        BT_GATT_PERM_READ | BT_GATT_PERM_WRITE),
);

/* This function sends a notification to a Client with the provided data,
 * given that the Client Characteristic Control Descripter has been set to Notify (0x1).
 * It also calls the on_sent() callback if successful
 */
void data_service_send(struct bt_conn *conn, const uint8_t *data, uint16_t len)
{
    /* 
     * The attribute for the TX characteristic is used with bt_gatt_is_subscribed 
     * to check whether notification has been enabled by the peer or not.
     * Attribute table: 0 = Service, 1 = Primary service, 2 = RX, 3 = TX, 4 = CCC.
     */
    const struct bt_gatt_attr *attr = &data_service.attrs[3]; 

    struct bt_gatt_notify_params params = 
    {
        .uuid   = BT_UUID_DATA_SERVICE_TX,
        .attr   = attr,
        .data   = data,
        .len    = len,
        .func   = on_sent
    };

    // Check whether notifications are enabled or not
    if(bt_gatt_is_subscribed(conn, attr, BT_GATT_CCC_NOTIFY)) 
    {
        // Send the notification
	    if(bt_gatt_notify_cb(conn, &params))
        {
            printk("Error, unable to send notification\n");
        }
    }
    else
    {
        printk("Warning, notification not enabled on the selected attribute\n");
    }
}

double getDiameter() 
{
    return dia;
}

void setDiameter(uint8_t diameter) 
{
    dia = diameter;
}

uint8_t getNbrOfAddresses() 
{
    return nbrAddresses;
}

void getAddress(char* outArray, uint8_t nbr) 
{
    switch (nbr)
    {
    case 1:
        for (uint8_t i=0; i<17; i++)
        {
            outArray[i] = address1[i];
        }    
        break;
    case 2:
        for (uint8_t i=0; i<17; i++)
        {
            outArray[i] = address2[i];
        }    
        break;
    case 3:
        for (uint8_t i=0; i<17; i++)
        {
            outArray[i] = address3[i];
        }    
        break;
    default:
        break;
    }
}

uint8_t getSensorInfos() 
{
    return infoSensors;
}

bool areNotificationsOn()
{
    return notificationsOn;
}
```

## src/dataService.h
```c
/**
 * @file 	DataService.h
 * @author 	Schwery Bastian (bastian98@gmx.ch)
 * @brief 	This class implements a rx/tx service
 * @version 0.1
 * @date 	2021-06
 * 
 * @copyright Copyright (c) 2021
 * 
 */

/*---------------------------------------------------------------------------
 * INCLUDES
 *--------------------------------------------------------------------------*/ 
#include <bluetooth/gatt.h>

/*---------------------------------------------------------------------------
 * DEFINES
 *--------------------------------------------------------------------------*/ 
#define DATA_SERVICE_UUID 0xd4, 0x86, 0x48, 0x24, 0x54, 0xB3, 0x43, 0xA1, \
			            0xBC, 0x20, 0x97, 0x8F, 0xC3, 0x76, 0xC2, 0x75

#define RX_CHARACTERISTIC_UUID  0xA6, 0xE8, 0xC4, 0x60, 0x7E, 0xAA, 0x41, 0x6B, \
			                    0x95, 0xD4, 0x9D, 0xCC, 0x08, 0x4F, 0xCF, 0x6A

#define TX_CHARACTERISTIC_UUID  0xED, 0xAA, 0x20, 0x11, 0x92, 0xE7, 0x43, 0x5A, \
			                    0xAA, 0xE9, 0x94, 0x43, 0x35, 0x6A, 0xD4, 0xD3

// declaration of the UUID's
#define BT_UUID_DATA_SERVICE      BT_UUID_DECLARE_128(DATA_SERVICE_UUID)
#define BT_UUID_DATA_SERVICE_RX   BT_UUID_DECLARE_128(RX_CHARACTERISTIC_UUID)
#define BT_UUID_DATA_SERVICE_TX   BT_UUID_DECLARE_128(TX_CHARACTERISTIC_UUID)

#define MAX_TRANSMIT_SIZE 240	

/**
 * @brief Callback type for when new data is received
 * 
 */
typedef void (*data_rx_cb_t)(uint8_t *data, uint8_t length);

/** 
 * @brief Callback struct used by the data_service Service 
 * 
*/
struct data_service_cb 
{
	// Data received callback
	data_rx_cb_t data_rx_cb;
};

/** 
 * @brief initialize service 
 * 
 *  @return uint8_t error code
*/
uint8_t data_service_init(void);

/** 
 * @brief  send data to the device given by connection parameter
 * 
 * @param conn connection to send the data
 * @param data the data to send
 * @param len length of the data to send
*/
void data_service_send(struct bt_conn *conn, const uint8_t *data, uint16_t len);

/** 
 *  @brief get the diameter value
 * 
 *  @return the diameter value in cm
*/
double getDiameter();

/**
 * @brief Set the diameter value
 * 
 * @param diameter value 
 */
void setDiameter(uint8_t diameter);

/** 
 *  @brief get number of addresses the user selected
 * 
 *  @return number of addresses
*/
uint8_t getNbrOfAddresses();

/** 
 * @brief save the address with the corresponing number at the given array
 * 
 * @param outArray the address to save the searched array
 * @param nbr the nbr of the array to save
*/
void getAddress(char* outArray, uint8_t nbr);

/**
 * @brief Get informations about which sensors 
 * 		  the user wants to connect
 * 
 * @return uint8_t info about sensors
 * 		   just one speed sensor: 1
 *		   just one cadence sensor: 2
 *		   speed and cadence sensors: 3
 *		   speed and cadence and heart rate sensor: 4
 * 		   speed and heart rate sensor: 5
 * 		   cadence and heart rate sensor: 6
 * 		   just one heart rate sensor: 7
 */
uint8_t getSensorInfos();

/**
 * @brief get information if notifications are enabled in application
 * 
 * @return true if enabled
 * @return false if is not enabled
 */
bool areNotificationsOn();
```
